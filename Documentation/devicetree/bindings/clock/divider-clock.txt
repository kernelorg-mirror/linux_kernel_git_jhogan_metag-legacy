## arch/metag/Kconfig.board
```kconfig
if SOC_TZ1090

choice
	prompt "Board support"

config COMET_NOBOARD
	bool "None"
	help
	  No specific board support.

config COMET_BUB
	bool "Comet bring-up-board on-board peripherals (flash)"
	help
	  Support for the bring-up-board on-board peripherals.

config TZ1090_01XX
	bool "01SP/01TT (Comet Metamorph/Minimorph) on-board peripherals"
	help
	  Support for on-board peripherals on the 01SP (Comet Metamorph) and
	  01TT (Comet Minimorph) boards.

config POLARIS
	bool "01XK (Polaris) on-board peripherals"
	select METAG_COREMEM
	help
	  Support for the Polaris on-board peripherals.

endchoice

endif

config COMET_BUB_XTAL3
	bool "Crystal in XTAL3 (32.768KHz)"
	depends on COMET_BUB
	help
	  Select this option if the bring-up-board has a 32.768 KHz crystal in
	  XTAL3.

config COMET_BUB_DISPLAY
	bool "Comet bring-up-board 640x480 TFT display"
	depends on COMET_BUB
	select FB
	select FB_PDP
	help
	  Support for the bring-up-board TFT display (640x480).

config COMET_BUB_LCD
	bool "Comet Bring-up-board LCD display"
	depends on COMET_BUB
	help
	  Support for the LCD Display.

choice
	prompt "Chorus2 display type"
	depends on SOC_CHORUS2
	default CHORUS2_NODISPLAY

config CHORUS2_NODISPLAY
	bool "None"
	help
	  No display support.

config CHORUS2_LCD
	bool "LCD"
	help
	  Support for LCD displays.

config CHORUS2_TFT
	bool "TFT"
	help
	  Support for TFT displays.

endchoice

config ATP_DP
	bool "ATP-dp on-board peripherals (SD card, flash)"
	depends on SOC_CHORUS2
	help
	  Support for ATP-dp on-board peripherals.

config ATP_DP_DISPLAY1
	bool "ATP-dp:display1 240x320 TFT board"
	depends on ATP_DP && CHORUS2_TFT
	select FB
	select FB_PDP
	select I2C
	select I2C_CHORUS2
	help
	  Support for ATP-dp:display1 TFT daughterboard (240x320).

config ATP_DP_DISPLAY2
	bool "ATP-dp:display2 640x480 TFT board"
	depends on ATP_DP && CHORUS2_TFT
	select FB
	select FB_PDP
	select I2C
	select I2C_CHORUS2
	help
	  Support for ATP-dp:display2 TFT daughterboard (640x480).

config ATP_DP_LAN1
	bool "ATP-dp:lan1 ethernet board"
	depends on ATP_DP
	help
	  Support for ATP-dp:lan1 ethernet daughterboard.

config VIVALDI
	bool "Vivaldi on-board peripherals (flash, wifi)"
	depends on SOC_CHORUS2
	help
	  Support for Vivaldi on-board peripherals.

choice
	prompt "01SP/01TT Video output"
	depends on TZ1090_01XX
	default TZ1090_01XX_HDMI_VID_OUT
	help
	  Select which component to drive as the display.

config TZ1090_01XX_NO_VID_OUT
	bool "None"
	help
	  Don't support any Video Out components.

config TZ1090_01XX_HDMI_VID_OUT
	bool "HDMI"
	select FB
	select FB_PDP
	select FB_MODE_HELPERS
	help
	  Suport for 01SP/01TT HDMI Video Out component.

config TZ1090_01XX_DISPLAY
	bool "640x480 TFT display"
	select FB
	select FB_PDP
	help
	  Support for the 01SP/01TT TFT display (640x480).

endchoice

config TZ1090_01XX_HDMI_AUDIO
	bool "01SP/01TT HDMI audio out"
	depends on TZ1090_01XX
	depends on TZ1090_01XX_HDMI_VID_OUT
	help
	  Support for 01SP/01TT HDMI Audio out component.

config TZ1090_01XX_HDMI_AUDIO_51
	bool "01SP/01TT HDMI 5.1 audio out"
	depends on TZ1090_01XX
	depends on TZ1090_01XX_HDMI_VID_OUT
	depends on TZ1090_01XX_HDMI_AUDIO
	help
	  Configure the HDMI to support 5.1 Audio.

config SENSIA_TOUCHSCREEN
	bool "Sensia touchscreen"
	depends on COMET_BUB_DISPLAY || TZ1090_01XX_DISPLAY || POLARIS
	default y if POLARIS
	help
	  Support for the Sensia touchscreen.
```

## arch/metag/Kconfig.soc
```kconfig
choice
	prompt "SoC Type"
	default META21_FPGA

config META12_FPGA
	bool "Meta 1.2 FPGA"
	select METAG_META12
	help
	  This is a Meta 1.2 FPGA bitstream, just a bare CPU.

config SOC_CHORUS2
	bool "Chorus2 SoC"
	select METAG_META12
	select ARCH_REQUIRE_GPIOLIB
	select HAVE_CLK
	select IMG_DMAC
	select METAG_ROM_WRAPPERS
	help
	  This is a Frontier Silicon Chorus2 SoC.

config META21_FPGA
	bool "Meta 2.1 FPGA"
	select METAG_META21
	help
	  This is a Meta 2.1 FPGA bitstream, just a bare CPU.

config SOC_TZ1090
	bool "Toumaz Xenif TZ1090 SoC (Comet)"
	select ARCH_REQUIRE_GPIOLIB
	select COMMON_CLK
	select DMADEVICES
	select IMGPDC_IRQ
	select MDC_DMA
	select METAG_LNKGET_AROUND_CACHE
	select METAG_META21
	select METAG_SMP_WRITE_REORDERING
	select PINCTRL
	select PINCTRL_TZ1090
	select PINCTRL_TZ1090_PDC
	select TZ1090_MDC_DMA
	help
	  This is a Toumaz Technology Xenif TZ1090 (A.K.A. Comet) SoC containing
	  a 2-threaded HTP.

endchoice

menu "SoC configuration"

if SOC_TZ1090

config SOC_COMET_ES1
	bool "Prototype Silicon (ES1)"
	select FB_PDP_QUEUE_CLUT
	help
	  Select this if using Prototype ES1 Silicon

config COMET_CACHEFLUSH_BUG
	depends on SMP && SOC_COMET_ES1
	def_bool y

config ARCH_SUSPEND_POSSIBLE
	def_bool y

config METAG_SUSPEND_MEM
	bool "Suspend to RAM support"
	depends on SUSPEND
	help
	  Say Y here to enable Suspend to RAM support for Comet.

config COMET_SUSPEND_MEM_SAFE
	bool "Fake Suspend to RAM in SAFE mode (development only)"
	depends on METAG_SUSPEND_MEM
	help
	  Say Y here to fake Suspend to RAM using a watchdog reset if the SoC is
	  in SAFE mode.

	  This is intended for purely development purposes to emulate suspend to
	  RAM on boards which have SAFE mode asserted. Instead of powering off
	  the SoC and allowing the PDC to control wakeup, it blocks waiting for
	  the wake interrupt and watchdog soft resets. This causes the PDC to be
	  reset too, therefore wake interrupts will not be detected by Linux on
	  resume.

menu "DMA channel assigment"

config SOC_COMET_DMA0
	bool "Comet DMA channel 0"
	default y
	help
	  Make this DMA channel available to Linux.

config SOC_COMET_DMA1
	bool "Comet DMA channel 1"
	default y
	help
	  Make this DMA channel available to Linux.

config SOC_COMET_DMA2
	bool "Comet DMA Channel 2"
	default y
	help
	  Make this DMA channel available to Linux.

config SOC_COMET_DMA3
	bool "Comet DMA Channel 3"
	default y
	help
	  Make this DMA channel available to Linux.

config SOC_COMET_DMA4
	bool "Comet DMA Channel 4"
	default y
	help
	  Make this DMA channel available to Linux.

config SOC_COMET_DMA5
	bool "Comet DMA Channel 5"
	default y
	help
	  Make this DMA channel available to Linux.

config SOC_COMET_DMA6
	bool "Comet DMA Channel 6"
	default y
	help
	  Make this DMA channel available to Linux.

config SOC_COMET_DMA7
	bool "Comet DMA Channel 7"
	default y
	help
	  Make this DMA channel available to Linux.


endmenu

config SOC_COMET_AUDIOCODEC
	tristate "Expose audio codec setup"
	depends on SND_SOC_TANSEN
	help
	  This will expose audio codec setup through sysfs.

endif

if SOC_CHORUS2

# Chorus2 specific options

menu "DMA channel assigment"

config SOC_CHORUSX_DMA0
	bool "Chorus2/3 DMA channel 0"
	default y
	help
	  Make this DMA channel available to Linux.

config SOC_CHORUSX_DMA1
	bool "Chorus2/3 DMA channel 1"
	default y
	help
	  Make this DMA channel available to Linux.

config SOC_CHORUSX_DMA2
	bool "Chorus2/3 DMA channel 2"
	default y
	help
	  Make this DMA channel available to Linux.

config SOC_CHORUSX_DMA3
	bool "Chorus2/3 DMA channel 3"
	default y
	help
	  Make this DMA channel available to Linux.

config SOC_CHORUSX_DMA4
	bool "Chorus2/3 DMA channel 4"
	default y
	help
	  Make this DMA channel available to Linux.

config SOC_CHORUSX_DMA5
	bool "Chorus2/3 DMA channel 5"
	default y
	help
	  Make this DMA channel available to Linux.

config SOC_CHORUSX_DMA6
	bool "Chorus2/3 DMA channel 6"
	default y
	help
	  Make this DMA channel available to Linux.

config SOC_CHORUSX_DMA7
	bool "Chorus2/3 DMA channel 7"
	default y
	help
	  Make this DMA channel available to Linux.

config SOC_CHORUSX_DMA8
	bool "Chorus2/3 DMA channel 8"
	default y
	help
	  Make this DMA channel available to Linux.

config SOC_CHORUSX_DMA9
	bool "Chorus2/3 DMA channel 9"
	default y
	help
	  Make this DMA channel available to Linux.

config SOC_CHORUSX_DMA10
	bool "Chorus2/3 DMA channel 10"
	default y
	help
	  Make this DMA channel available to Linux.

config SOC_CHORUSX_DMA11
	bool "Chorus2/3 DMA channel 11"
	default y
	help
	  Make this DMA channel available to Linux.

endmenu

endif

if METAG_META21

# Meta 2.x specific options

config METAG_META21_MMU
	bool "Meta 2.x MMU mode"
	default y
	help
	  Use the Meta 2.x MMU in extended mode.

config METAG_UNALIGNED
	bool "Meta 2.x unaligned access checking"
	default y
	help
	  All memory accesses will be checked for alignment and an exception
	  raised on unaligned accesses. This feature does cost performance
	  but without it there will be no notification of this type of error.

config METAG_USER_TCM
	bool "Meta on-chip memory support for userland"
	select GENERIC_ALLOCATOR
	default y
	help
	  Allow the on-chip memories of Meta SoCs to be used by user
	  applications.

endif

config METAG_HALT_ON_PANIC
	bool "Halt the core on panic"
	help
	  Halt the core when a panic occurs. This is useful when running
	  pre-production silicon or in an FPGA environment.

endmenu
```

## arch/metag/configs/chorus2_defconfig
```kconfig
# CONFIG_LOCALVERSION_AUTO is not set
# CONFIG_SWAP is not set
CONFIG_SYSVIPC=y
CONFIG_SYSFS_DEPRECATED=y
CONFIG_SYSFS_DEPRECATED_V2=y
CONFIG_BLK_DEV_INITRD=y
CONFIG_INITRAMFS_SOURCE="arch/metag/boot/ramdisk.cpio"
CONFIG_INITRAMFS_COMPRESSION_GZIP=y
CONFIG_KALLSYMS_ALL=y
CONFIG_SLAB=y
CONFIG_MODULES=y
# CONFIG_BLK_DEV_BSG is not set
CONFIG_PARTITION_ADVANCED=y
# CONFIG_MSDOS_PARTITION is not set
# CONFIG_IOSCHED_DEADLINE is not set
# CONFIG_IOSCHED_CFQ is not set
CONFIG_FLATMEM_MANUAL=y
CONFIG_SOC_CHORUS2=y
CONFIG_METAG_DA=y
CONFIG_CHORUS2_TFT=y
CONFIG_ATP_DP=y
CONFIG_ATP_DP_LAN1=y
CONFIG_HZ_100=y
# CONFIG_CORE_DUMP_DEFAULT_ELF_HEADERS is not set
CONFIG_NET=y
CONFIG_PACKET=y
CONFIG_UNIX=y
CONFIG_INET=y
# CONFIG_INET_XFRM_MODE_TRANSPORT is not set
# CONFIG_INET_XFRM_MODE_TUNNEL is not set
# CONFIG_INET_XFRM_MODE_BEET is not set
# CONFIG_INET_LRO is not set
# CONFIG_INET_DIAG is not set
# CONFIG_IPV6 is not set
# CONFIG_WIRELESS is not set
CONFIG_DEVTMPFS=y
CONFIG_DEVTMPFS_MOUNT=y
# CONFIG_STANDALONE is not set
# CONFIG_PREVENT_FIRMWARE_BUILD is not set
# CONFIG_FW_LOADER is not set
CONFIG_BLK_DEV_RAM=y
CONFIG_BLK_DEV_RAM_COUNT=1
CONFIG_NETDEVICES=y
# CONFIG_NET_VENDOR_BROADCOM is not set
# CONFIG_NET_VENDOR_INTEL is not set
# CONFIG_NET_VENDOR_MARVELL is not set
# CONFIG_NET_VENDOR_MICREL is not set
# CONFIG_NET_VENDOR_MICROCHIP is not set
# CONFIG_NET_VENDOR_NATSEMI is not set
# CONFIG_NET_VENDOR_SEEQ is not set
CONFIG_SMSC911X=y
# CONFIG_NET_VENDOR_STMICRO is not set
# CONFIG_WLAN is not set
# CONFIG_INPUT is not set
# CONFIG_SERIO is not set
# CONFIG_VT is not set
# CONFIG_LEGACY_PTYS is not set
CONFIG_DA_TTY=y
CONFIG_DA_CONSOLE=y
# CONFIG_DEVKMEM is not set
CONFIG_SERIAL_8250=y
CONFIG_SERIAL_8250_CONSOLE=y
CONFIG_SERIAL_8250_NR_UARTS=2
CONFIG_SERIAL_8250_RUNTIME_UARTS=2
CONFIG_SERIAL_8250_DW=y
# CONFIG_HW_RANDOM is not set
CONFIG_I2C=y
CONFIG_I2C_CHARDEV=y
# CONFIG_I2C_HELPER_AUTO is not set
CONFIG_I2C_CHORUS2=y
CONFIG_SPI=y
CONFIG_GPIO_PCA953X=y
# CONFIG_HWMON is not set
CONFIG_USB=y
CONFIG_USB_EHCI_HCD=y
CONFIG_USB_EHCI_ROOT_HUB_TT=y
CONFIG_MMC=y
CONFIG_MMC_SPI=y
CONFIG_AUXDISPLAY=y
# CONFIG_DNOTIFY is not set
CONFIG_TMPFS=y
# CONFIG_MISC_FILESYSTEMS is not set
CONFIG_NFS_FS=y
# CONFIG_ENABLE_WARN_DEPRECATED is not set
# CONFIG_ENABLE_MUST_CHECK is not set
# CONFIG_SCHED_DEBUG is not set
CONFIG_DEBUG_INFO=y
# CONFIG_CRYPTO_ANSI_CPRNG is not set
# CONFIG_CRYPTO_HW is not set
```

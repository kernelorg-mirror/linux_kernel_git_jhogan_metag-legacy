## Documentation/devicetree/bindings/clock/divider-clock.txt
```
Binding for generic integer clock divider.

This binding uses the common clock binding[1].

[1] Documentation/devicetree/bindings/clock/clock-bindings.txt

Required properties:
- compatible         : Shall be "divider-clock".
- #clock-cells       : From common clock binding; shall be set to 0.
- reg                : Address of divider register.
- shift              : Shift of field in divider register.
- width              : Width of field in divider register.
- clocks             : From common clock binding.

Required source clocks:
- 0                  : Reference clock which is divided to produce the output
                       clock (doesn't have to be named).

Optional properties:
- one-based          : Indicates that register field stores the divisor directly
                       rather than the default of divisor-1.
- power-of-two       : Indicates that register field stores log2(divisor) rather
                       that the default of divisor-1.
- clock-output-names : From common clock binding.
- linux,clk-read-only: Flag to indicate that the divide shouldn't be altered.
- default-divide     : Default divider value.

Example:
	clock {
		compatible = "divider-clock";
		#clock-cells = <0>;
		clocks = <&sys_pll>;
		reg = <0x02005914 0x4>;	/* CR_TOP_SYSCLK_DIV */
		shift = <0>;		/* CR_TOP_SYSDIV */
		width = <8>;
		clock-output-names = "sysclk_div";
	};
```

## Documentation/devicetree/bindings/clock/img,meta-gate-clock.txt
```
Binding for clock gate requiring global Meta locking.

This binding uses the common clock binding[1].

[1] Documentation/devicetree/bindings/clock/clock-bindings.txt

Required properties:
- compatible         : Shall be "img,meta-mux-clock".
- #clock-cells       : From common clock binding; shall be set to 0.
- reg                : Address of configuration register.
- bit                : Bit number of gate switch in configuration register.
- clocks             : From common clock binding.

Required source clocks:
- 0                  : Input clock that can be gated (doesn't have to be named).

Optional properties:
- clock-output-names : From common clock binding.

Example:
	clock {
		compatible = "img,meta-gate-clock";
		#clock-cells = <0>;
		clocks = <&sys_clk>;
		reg = <0x02004010 0x4>;
		bit = <0>;
		clock-output-names = "scb0";
	};
```

## Documentation/devicetree/bindings/clock/img,meta-mux-clock.txt
```
Binding for clock multiplexer requiring global Meta locking.

This binding uses the common clock binding[1].

[1] Documentation/devicetree/bindings/clock/clock-bindings.txt

Required properties:
- compatible         : Shall be "img,meta-mux-clock".
- #clock-cells       : From common clock binding; shall be set to 0.
- reg                : Address of configuration register.
- shift              : Shift of mux value field in configuration register.
- width              : Width of mux value field in configuration register.
- clocks             : From common clock binding.

Required source clocks:
- 0..(1<<width)-1    : Input clocks to multiplex (don't have to be named).

Optional properties:
- clock-output-names : From common clock binding.
- default-clock      : Mux value to set initially.
- linux,clk-set-rate-parent : Allow modification of parent clock.
- linux,clk-set-rate-remux : Allow remux in response to rate change.

Example:
	clock {
		compatible = "img,meta-mux-clock";
		#clock-cells = <0>;
		clocks = <&xtal1>,
			 <&xtal2>;
		reg = <0x02005908 0x4>;
		shift = <0>;
		width = <1>;
		clock-output-names = "sysclk0_sw";
		default-clock = <1>; /* default to xtal2 */
	};
```

## Documentation/devicetree/bindings/clock/img,tz1090-deleter.txt
```
Binding for TZ1090 clock deleter.

This binding uses the common clock binding[1]. The TZ1090 clock deleters can be
configured to delete a certain fraction of the input clock pulses. For a
configuration field of "width" bits with the value "delete_cycles",
delete_cycles cycles are deleted out of every 1 << width cycles, so the output
frequency is:

    f_out = f_in * ((1 << width) - config) / (1 << width)

[1] Documentation/devicetree/bindings/clock/clock-bindings.txt

Required properties:
- compatible         : Shall be "img,tz1090-deleter".
- #clock-cells       : From common clock binding; shall be set to 0.
- reg                : Address of configuration register.
- shift              : Shift of config value field in configuration register.
- width              : Width of config value field in configuration register.
- clocks             : From common clock binding.

Required source clocks:
- 0                  : Reference clock which is deleted to produce the output
                       clock (doesn't have to be named).

Optional properties:
- clock-output-names : From common clock binding.

Example:
	meta_clkdelete {
		compatible = "img,tz1090-deleter";
		#clock-cells = <0>;
		clocks = <&sys_clk_x2_undeleted>;
		reg = <0x0200591c 0x4>;	/* CR_TOP_META_CLKDELETE */
		shift = <0>;		/* CR_TOP_META_CLKDELETE */
		width = <12>;
		clock-output-names = "meta";
	};
```

## Documentation/devicetree/bindings/clock/img,tz1090-pll.txt
```
Binding for TZ1090 Phase-Lock Loop (PLL) clocks.

This binding uses the common clock binding[1]. These PLLs are configured with 2
registers specified with the reg property. These contain various fields which
among other things specify the reference divider value (r), the frequency
divider value (f), and the output divider value (od). When enabled, the output
clock rate is:

    f_out = f_ref / r * (f / 2) / od

[1] Documentation/devicetree/bindings/clock/clock-bindings.txt

Required properties:
- compatible         : Shall be "img,tz1090-pll".
- #clock-cells       : From common clock binding; shall be set to 0.
- reg                : Address of configuration register pair.
- clocks             : From common clock binding.

Required source clocks:
- 0                  : Reference clock used to generate the output clock
                       (doesn't have to be named).

Optional properties:
- clock-output-names : From common clock binding.

Example:
	sys_pll {
		compatible = "img,tz1090-pll";
		#clock-cells = <0>;
		clocks = <&sysclk0_sw>;
		reg = <0x02005950 0x8>;	/* CR_TOP_SYSPLL_CTL{0,1} */
		clock-output-names = "sys_pll";
	};
```

## Documentation/devicetree/bindings/clock/specified-clock.txt
```
Binding for fixed-rate clock sources with readable configuration.

This binding uses the common clock binding[1].

[1] Documentation/devicetree/bindings/clock/clock-bindings.txt

Required properties:
- compatible         : Shall be "specified-clock".
- #clock-cells       : From common clock binding; shall be set to 0.
- reg                : Address of configuration register.
- shift              : Shift of config value field in configuration register.
- width              : Width of config value field in configuration register.
- clock-frequency    : Frequency mapping of clock. Consecutive pairs of cells
                       represent the config value to match and the clock
                       frequency in Hz for that config value.

Optional properties:
- clock-output-names : From common clock binding.

Example:
	clock {
		compatible = "specified-clock";
		#clock-cells = <0>;
		reg = <0x02004004 0x4>;	/* CR_PERIP_RESET_CFG */
		shift = <8>;		/* FXTAL */
		width = <4>;
		clock-frequency =
		/*	 FXTAL	Frequency */
			<0	16384000>,
			<1	19200000>,
			<2	24000000>,
			<3	24576000>,
			<4	26000000>,
			<5	36000000>,
			<6	36864000>,
			<7	38400000>,
			<8	40000000>;
		clock-output-names = "xtal1";
	};
```

## Documentation/devicetree/bindings/dma/img-mdc-dma.txt
```
* Imagination Technologies Meta DMA Controller (MDC)

Required properties:
- #dma-cells : Must be <2>. Used by slave devices to request a DMA channel.
- compatible : Should be "img,mdc-dma".
- reg        : Should contain DMA registers location and length. This should include
  all of the per-channel registers.
- interrupts : Should contain all of the per-channel DMA interrupts.

Examples:

dma: dma-controller@0200c000 {
	#dma-cells = <2>;
	compatible = "img,mdc-dma";
	reg = <0x0200c000 0x1000>;
	interrupts = < 21 4
		       22 4
		       23 4
		       24 4
		       25 4
		       26 4
		       27 4
		       28 4 >;
};

DMA clients connected to the Meta DMA Controller (MDC) must comply to the format
described in the dma.txt file, using a two-cell specifier for each channel. The
cells are:

1. The number of the DMA peripheral.
2. The DMA request line number.

Example:

spi1: spi@02004e00 {
	...
	dmas = <&dma 7 0xffffffff
		&dma 8 0xffffffff>; /* -1 for any channel */
	dma-names = "rx", "tx";
};
```

## Documentation/devicetree/bindings/dma/tz1090-mdc-dma.txt
```
* Toumaz Xenif TZ1090 (Comet) specific callbacks for the Imagination Technologies Meta DMA Controller (MDC)

Required properties:
- compatible   : Should be "img,tz1090-mdc-dma".
- The remaining properties are described in the img-mdc-dma.txt file.

Examples

dma: dma-controller@0200c000 {
	#dma-cells = <2>;
	compatible = "img,tz1090-mdc-dma";
	reg = <0x0200c000 0x1000>;
	interrupts = < 21 4
		       22 4
		       23 4
		       24 4
		       25 4
		       26 4
		       27 4
		       28 4 >;
};

DMA clients should use the properties described in the img-mdc-dma.txt file.
```

## Documentation/devicetree/bindings/gpio/gpio-tz1090.txt
```
ImgTec TZ1090 GPIO Controller

Required properties:
- compatible: Compatible property value should be "img,tz1090-gpio".

- reg: Physical base address of the controller and length of memory mapped
  region.

- #address-cells: Should be 1 (for bank subnodes)

- #size-cells: Should be 0 (for bank subnodes)

- Each bank of GPIOs should have a subnode to represent it.

  Bank subnode required properties:
  - reg: Index of bank in the range 0 to 2.

  - gpio-controller: Specifies that the node is a gpio controller.

  - #gpio-cells: Should be 2. The syntax of the gpio specifier used by client
    nodes should have the following values.
       <[phandle of the gpio controller node]
        [gpio number within the gpio bank]
        [gpio flags]>

    Values for gpio specifier:
    - GPIO number: a value in the range 0 to 29.
    - GPIO flags: bit field of flags:
        1: active low

  Bank subnode optional properties:
  - gpio-ranges: Mapping to pin controller pins

  - interrupts: Interrupt for the entire bank

  - interrupt-controller: Specifies that the node is an interrupt controller

  - #interrupt-cells: Should be 2. The syntax of the interrupt specifier used by
    client nodes should have the following values.
       <[phandle of the interurupt controller]
        [gpio number within the gpio bank]
        [irq flags]>

    Values for irq specifier:
    - GPIO number: a value in the range 0 to 29
    - IRQ flags: value to describe edge and level triggering
        1: trigger on rising edge
        2: trigger on falling edge
        3: trigger on both rising and falling edges
        4: trigger when high
        8: trigger when low



Example:

	gpios: gpio-controller@02005800 {
		#address-cells = <1>;
		#size-cells = <0>;
		compatible = "img,tz1090-gpio";
		reg = <0x02005800 0x90>;

		/* bank 0 with an interrupt */
		gpios0: bank@0 {
			#gpio-cells = <2>;
			#interrupt-cells = <2>;
			reg = <0>;
			interrupts = <13 4 /* level */>;
			gpio-controller;
			gpio-ranges = <&pinctrl 0 30>;
			interrupt-controller;
		};

		/* bank 2 without interrupt */
		gpios2: bank@2 {
			#gpio-cells = <2>;
			reg = <2>;
			gpio-controller;
			gpio-ranges = <&pinctrl 60 30>;
		};
	};
```

## Documentation/devicetree/bindings/i2c/i2c-chorus2.txt
```
ImgTec Serial Control Protocol (SCB) I2C Controller for Chorus2 compatible
boards

Required properties:
- compatible: Must be "img,chorus2-i2c"
- reg
- interrupts
- id: The bus id number
- #address-cells = <1>;
- #size-cells = <0>;

Optional properties:
- Child nodes conforming to i2s bus binding
```

## Documentation/devicetree/bindings/i2c/i2c-imgscb.txt
```
ImgTec Serial Control Protocol (SCB) I2C Controller:

Required properties:
- compatible : Must be "img,scb";
- reg
- interrupts
- clocks : A reference to the SCB clock node;
- bit-rate : Speed of bus in Hz;
- bus-delay : Bus delay in ms;
- quirks : Quirks present on the hardware:
  - 0x00000001 : write read fence.
                 2 writes required to ensure subsequent read reflects the
                 effects of a prior write, due to clock domain crossing problem.
  - 0x00000002 : atomic mode only.
                 Automatic mode unreliable when using different clock domain for
                 data clock. This can be worked around by forcing atomic mode
                 only with this quirk (slower), or using the same clock domain.
- #address-cells = <1>;
- #size-cells = <0>;

Optional properties:
- pinctrl-names : Can contain "default"
- pinctrl-0 : Pin control maps for when enabled
- linux,i2c-index: Can be used to override the I2C bus number. This is useful
  when some of the I2C adapters are used by other non-Linux cores so would get
  numbered incorrectly by default.
- Child nodes conforming to i2c bus binding
```

## Documentation/devicetree/bindings/input/img-ir.txt
```
* ImgTec Infrared (IR) decoder

Required properties:
- compatible:		Should be "img,ir"
- reg:			physical base address of the controller and length of
			memory mapped region.
- interrupts:		The interrupt number to the cpu should be specified. The
			number of cells representing a interrupt depends on the
			parent interrupt controller.

Example:

	ir@02006200 {
		compatible = "img,ir";
		reg = <0x02006200 0x100>;
		interrupts = <29 4>;
	};
```

## Documentation/devicetree/bindings/metag/meta-intc.txt
```
* Meta External Trigger Controller Binding

This binding specifies what properties must be available in the device tree
representation of a Meta external trigger controller.

Required properties:

    - compatible: Specifies the compatibility list for the interrupt controller.
      The type shall be <string> and the value shall include "img,meta-intc".

    - num-banks: Specifies the number of interrupt banks (each of which can
      handle 32 interrupt sources).

    - interrupt-controller: The presence of this property identifies the node
      as an interrupt controller. No property value shall be defined.

    - #interrupt-cells: Specifies the number of cells needed to encode an
      interrupt source. The type shall be a <u32> and the value shall be 2.

    - #address-cells: Specifies the number of cells needed to encode an
      address. The type shall be <u32> and the value shall be 0. As such,
      'interrupt-map' nodes do not have to specify a parent unit address.

Optional properties:

    - no-mask: The controller doesn't have any mask registers.

    - default-level: List of default level bitfields, one for each bank, where
      each set bit indicates that the interrupt should be level sensitive by
      default rather than edge. The purpose of this is mainly to ease the
      transition to device tree from platform data. It should not be necessary
      if all IRQ users are configured with devicetree as each one should set the
      flow type in the interrupt specifier.

* Interrupt Specifier Definition

  Interrupt specifiers consists of 2 cells encoded as follows:

    - <1st-cell>: The interrupt-number that identifies the interrupt source.

    - <2nd-cell>: The Linux interrupt flags containing level-sense information,
                  encoded as follows:
                    1 = edge triggered
                    4 = level-sensitive

* Examples

Example 1:

	/*
	 * Meta external trigger block
	 */
	intc: intc {
		// This is an interrupt controller node.
		interrupt-controller;

		// No address cells so that 'interrupt-map' nodes which
		// reference this interrupt controller node do not need a parent
		// address specifier.
		#address-cells = <0>;

		// Two cells to encode interrupt sources.
		#interrupt-cells = <2>;

		// Number of interrupt banks
		num-banks = <2>;

		// IRQs 0-35 are level sensitive, except 16 and 34
		default-level = <0xfffeffff 0xb>;

		// No HWMASKEXT is available (specify on Chorus2 and Comet ES1)
		no-mask;

		// Compatible with Meta hardware trigger block.
		compatible = "img,meta-intc";
	};

Example 2:

	/*
	 * An interrupt generating device that is wired to a Meta external
	 * trigger block.
	 */
	uart1: uart@0x02004c00 {
		// Interrupt source '5' that is level-sensitive.
		// Note that there are only two cells as specified in the
		// interrupt parent's '#interrupt-cells' property.
		interrupts = <5 4 /* level */>;

		// The interrupt controller that this device is wired to.
		interrupt-parent = <&intc>;
	};
```

## Documentation/devicetree/bindings/misc/img,tz1090-2d.txt
```
Binding for 2D block in TZ1090.

Required properties:
- compatible         : Shall be "img,tz1090-2d".
- reg                : Register address ranges.
                       0: The 2D block slave port.
                       1: The HEP register region.
- interrupts         : Interrupt specifier for 2D block interrupt.
- clocks             : 2D block clock.

Example:
	twod {
		compatible = "img,tz1090-2d";
		reg =	<0x02008900 0x100>,	/* slave port */
			<0x02008c00 0x400>;	/* HEP registers */
		interrupts = <34 0>;
		clocks = <&twod_sysclk>;
	};
```

## Documentation/devicetree/bindings/misc/img,tz1090-socif.txt
```
Binding for TZ1090 SOCIF error controller.

Required properties:
- compatible         : Shall be "img,tz1090-socif".
- reg                : Address of CR_SOCIF_TIMEOUT with size 0x8 to include
                       CR_SOCIF_STATUS too.
- interrupts         : Interrupt specifier for SOCIF error interrupt.

Example:
	socif {
		compatible = "img,tz1090-socif";
		reg = <0x02008c2c 0x8>;
		interrupts = <16 0>;
	};
```

## Documentation/devicetree/bindings/pinctrl/img,tz1090-pdc-pinctrl.txt
```
ImgTec TZ1090 PDC pin controller

Required properties:
- compatible: "img,tz1090-pdc-pinctrl"
- reg: Should contain the register physical address and length of the
  SOC_GPIO_CONTROL registers in the PDC register region.

Please refer to pinctrl-bindings.txt in this directory for details of the
common pinctrl bindings used by client devices, including the meaning of the
phrase "pin configuration node".

TZ1090-PDC's pin configuration nodes act as a container for an abitrary number
of subnodes. Each of these subnodes represents some desired configuration for a
pin, a group, or a list of pins or groups. This configuration can include the
mux function to select on those pin(s)/group(s), and various pin configuration
parameters, such as pull-up, drive strength, etc.

The name of each subnode is not important; all subnodes should be enumerated
and processed purely based on their content.

Each subnode only affects those parameters that are explicitly listed. In
other words, a subnode that lists a mux function but no pin configuration
parameters implies no information about any pin configuration parameters.
Similarly, a pin subnode that describes a pullup parameter implies no
information about e.g. the mux function. For this reason, even seemingly boolean
values are actually tristates in this binding: unspecified, off, or on.
Unspecified is represented as an absent property, and off/on are represented as
integer values 0 and 1.

Required subnode-properties:
- pins : An array of strings. Each string contains the name of a pin or group.
    Valid values for these names are listed below.

Optional subnode-properties:
- function: A string containing the name of the function to mux to the pin or
  group. Valid values for function names are listed below, including which
  pingroups can be muxed to them.
- tristate: Flag, put pin into high impedance state.
- pull-up: Flag, pull pin high.
- pull-down: Flag: pull pin low.
- bus-hold: Flag, weak latch last value on tristate bus.
- schmitt: Integer, enable or disable Schmitt trigger mode for the pins.
    0: no hysteresis
    1: schmitt trigger
- slew-rate: Integer, control slew rate of pins.
    0: slow (half frequency)
    1: fast
- drive-strength: Integer, control drive strength of pins in mA.
    2:  2mA
    4:  4mA
    8:  8mA
    12: 12mA
- power-on-start: Integer, power on start value of pins
    0: weak pull-down disabled
    1: weak pull-down for invalid power

Note that many of these properties are only valid for certain specific pins
or groups. See the TZ1090 TRM for complete details regarding which groups
support which functionality. The Linux pinctrl driver may also be a useful
reference.

Valid values for pin and group names are:

  pins:

    These all support tristate, pull-up, pull-down, and bus-hold (which can also
    be provided to any of the groups below to set it for all gpio pins in that
    group).

    gpio0, gpio1, sys_wake0, sys_wake1, sys_wake2, ir_data, ext_power.

  mux groups:

    These all support function.

    gpio0
        pins:       gpio0.
        function:   ir_mod_stable_out.
    gpio1
        pins:       gpio1.
        function:   ir_mod_power_out.

  drive groups:

    These support schmitt, slew-rate, drive-strength, and power-on-start.

    pdc
        pins:   gpio0, gpio1, sys_wake0, sys_wake1, sys_wake2, ir_data,
                ext_power.

Example:

	pinctrl_pdc: pinctrl@02006500 {
		#gpio-range-cells = <2>;
		compatible = "img,tz1090-pdc-pinctrl";
		reg = <0x02006500 0x100>;
	};

Example board file extracts:

	&pinctrl_pdc {
		pinctrl-names = "default";
		pinctrl-0 = <&syswake_default>;

		syswake_default: syswakes {
			syswake_cfg {
				pins =	"sys_wake0",
					"sys_wake1",
					"sys_wake2";
				pull-up;
			};
		};
		irmod_default: irmod {
			gpio0_cfg {
				pins =	"gpio0";
				function = "ir_mod_stable_out";
			};
			gpio1_cfg {
				pins =	"gpio1";
				function = "ir_mod_power_out";
			};
		};
	};

	ir: ir@02006200 {
		pinctrl-names = "default";
		pinctrl-0 = <&irmod_default>;
	};
```

## Documentation/devicetree/bindings/rtc/imgpdc-rtc.txt
```
* ImgTec PowerDown Controller (PDC) Real Time Clock (RTC)

Required properties:
- compatible:		Should be "img,pdc-rtc"
- reg:			physical base address of the controller and length of
			memory mapped region. May also contain another region
			with 1 or 2 non-volatile registers to aid Comet clock
			rate during poweroff workarounds.
- reg-names:		Should contain at least "regs".
			May also contain "nonvolatile".
- interrupts:		The interrupt number to the cpu should be specified. The
			number of cells representing a interrupt depends on the
			parent interrupt controller.

Optional properties:
- time-set-delay:	Number of seconds it takes to set the time.
- alarm-irq-delay:	Number of seconds that alarm interrupts are delayed.
			Must not exceed 59 seconds.

Example:

	rtc@02006100 {
		compatible = "img,pdc-rtc";
		reg = <0x02006100 0x100>,	/* regs */
		      <0x02006038 0x8>;		/* nonvolatile */
		reg-names = "regs", "nonvolatile";
		interrupts = <30 4>;
	};
```

## Documentation/devicetree/bindings/sound/img,tz1090-audio.txt
```
* Imagination Technologies audio complex for the TZ1090 SoC.

Required properties:
- compatible         : Must be "img,tz1090-audio".
- reg                : Register list containing the ADC control register,
the HP control register and the GTI port for the tansen codec.
- img,i2s-controller : phandle for the i2s controller.
- img,audio-codec    : phandle for the tansen codec.

Example:

sound {
	compatible = "img,tz1090-audio";
	reg = < 0x020059E0 0x4
		0x020059E4 0x4
		0x020059B8 0x4>;
	img,i2s-controller = <&i2s>;
	img,audio-codec = <&tansen>;
};
```

## Documentation/devicetree/bindings/sound/img-i2s.txt
```
* Imagination Technologies I2S controller

Required properties:
- compatible : Must be "img,i2s".
- reg        : A list containing the I2S audio-out and audio-in registers
and length respectively.
- interrupts : Should contain all the interrupts for audio out/in lines. The
interrupts for the output channels must be first followed by the input one.
- interrupt-names: The interrupt names "output0", "output1", "output2", "input".
- clocks     : A reference to the I2S clock node.
- dmas       : DMA client properties as described in img-mdc-dma.txt. The dmas
property should contain the DMA phandle along with the DMA peripheral and channel
number for each channel starting with the output channels first.

Example:

i2s: tz1090-i2s@02004f00 {
	compatible = "img,i2s";
	reg = < 0x02004f00 0x100 /* out */
		0x02005000 0x100 /* in */>;
	interrupts = < 9 4 /* level */
		       10 4 /* level */
		       11 4 /* level */
		       12 4 /* level */>;
	interrupt-names = "output0", "output1", "output2", "input";
	clocks = <&i2sout_sysclk>;
	dmas = <&dma 9 0xffffffff /* out */
		&dma 10 0xffffffff /* in */>;
};
```

## Documentation/devicetree/bindings/sound/tansen.txt
```
CosmicCircuits Tansen audio codec.

Required properties:
- compatible : Must be "cosmic,tansen".
- reg        : The GTI port register.

Example:

tansen: tansen@020059B8 {
	compatible = "cosmic,tansen";
	reg = <0x020059B8 0x4>; /* GTI CTRL register */
};
```

## Documentation/devicetree/bindings/spi/img-spi.txt
```
* Imagination Technologies SPI master controller.

Required properties:
- compatible     : Must be "img,spi"
- reg            : The register base for the controller.
- interrupts     : Interrupt line.
- clocks         : A reference to the SPI clock node.
- #address-cells : <1>, as required by the generic SPI binding.
- #size-cells    : <0>, as required by the generic SPI binding.

Optional properties:
- num-cs         : Number of chip-select pins.
- clock-frequency: Desired clock frequency. If not specified, it will use the default
one (40Mhz).
- dmas           : As described in dma.txt, dmaengine bindings for channel allocation.
- dma-names      : Similarly, required dmaengine bindings for the previously
mentioned 'dmas' property. For more information see the dma.txt text file. If
used, the dma channels should be named "rx" and "tx".

Child nodes follow the generic SPI binding described in spi-bus.txt

Example:

SoC configuration:

spi1: spi@02004e00 {
	#address-cells = <1>;
	#size-cells = <0>;
	compatible = "img,spi";
	reg = <0x02004e00 0x100>;
	interrupts = <8 4 /* level */>;
	clocks = <&spim1_clk>;
	num-cs = <3>;
	clock-frequency = <40000000>;
	dmas = <&dma 7 0xffffffff
		&dma 8 0xffffffff>; /* -1 for any channel */
	dma-names = "rx", "tx";
};

Board-specific configuration:

&spi1 {
	mtd@0 {
		compatible = "atmel,at45", "atmel,dataflash";
		spi-max-frequency = <20000000>;
		reg = <0>; /* chip select */
	};
};
```

## Documentation/devicetree/bindings/watchdog/imgpdc-wdt.txt
```
* ImgTec PowerDown Controller (PDC) Watchdog Timer (WDT)

Required properties:
- compatible : Should be "img,pdc-wdt"
- reg : Should contain WDT registers location and length
- interrupts : Should contain WDT interrupt

Examples:

wdt@02006000 {
	compatible = "img,pdc-wdt";
	reg = <0x02006000 0x20>;
	interrupts = <31 4>;
};
```

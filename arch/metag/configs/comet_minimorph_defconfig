## arch/metag/configs/comet_minimorph_defconfig
```kconfig
# CONFIG_LOCALVERSION_AUTO is not set
# CONFIG_SWAP is not set
CONFIG_SYSVIPC=y
CONFIG_SYSFS_DEPRECATED=y
CONFIG_SYSFS_DEPRECATED_V2=y
CONFIG_BLK_DEV_INITRD=y
CONFIG_INITRAMFS_SOURCE="arch/metag/boot/ramdisk.cpio"
CONFIG_INITRAMFS_COMPRESSION_GZIP=y
CONFIG_KALLSYMS_ALL=y
CONFIG_SLAB=y
CONFIG_MODULES=y
# CONFIG_BLK_DEV_BSG is not set
CONFIG_PARTITION_ADVANCED=y
# CONFIG_IOSCHED_DEADLINE is not set
# CONFIG_IOSCHED_CFQ is not set
CONFIG_FORCE_MAX_ZONEORDER=11
CONFIG_FLATMEM_MANUAL=y
CONFIG_SOC_TZ1090=y
# CONFIG_METAG_FPU is not set
CONFIG_METAG_DA=y
CONFIG_METAG_BUILTIN_DTB_NAME="tz1090_01tt"
CONFIG_TZ1090_01XX=y
CONFIG_TZ1090_01XX_HDMI_AUDIO=y
CONFIG_HZ_100=y
CONFIG_PM_RUNTIME=y
# CONFIG_CORE_DUMP_DEFAULT_ELF_HEADERS is not set
CONFIG_NET=y
CONFIG_PACKET=y
CONFIG_UNIX=y
CONFIG_INET=y
# CONFIG_INET_XFRM_MODE_TRANSPORT is not set
# CONFIG_INET_XFRM_MODE_TUNNEL is not set
# CONFIG_INET_XFRM_MODE_BEET is not set
# CONFIG_INET_LRO is not set
# CONFIG_INET_DIAG is not set
# CONFIG_IPV6 is not set
CONFIG_CFG80211=y
CONFIG_CFG80211_WEXT=y
CONFIG_MAC80211=y
CONFIG_DEVTMPFS=y
# CONFIG_STANDALONE is not set
# CONFIG_PREVENT_FIRMWARE_BUILD is not set
# CONFIG_FIRMWARE_IN_KERNEL is not set
CONFIG_MTD=y
CONFIG_MTD_CMDLINE_PARTS=y
CONFIG_MTD_BLOCK=y
CONFIG_MTD_DATAFLASH=y
CONFIG_MTD_DATAFLASH_OTP=y
CONFIG_BLK_DEV_RAM=y
CONFIG_BLK_DEV_RAM_COUNT=1
CONFIG_NETDEVICES=y
# CONFIG_ETHERNET is not set
CONFIG_USB_PEGASUS=y
CONFIG_USB_USBNET=y
# CONFIG_USB_NET_CDCETHER is not set
# CONFIG_USB_NET_CDC_NCM is not set
# CONFIG_USB_NET_NET1080 is not set
# CONFIG_USB_NET_CDC_SUBSET is not set
# CONFIG_USB_NET_ZAURUS is not set
CONFIG_UCCP310WLAN=m
# CONFIG_INPUT_MOUSEDEV_PSAUX is not set
CONFIG_INPUT_EVDEV=y
CONFIG_INPUT_EVBUG=y
# CONFIG_KEYBOARD_ATKBD is not set
CONFIG_KEYBOARD_GPIO=y
# CONFIG_INPUT_MOUSE is not set
# CONFIG_SERIO is not set
# CONFIG_CONSOLE_TRANSLATIONS is not set
# CONFIG_LEGACY_PTYS is not set
CONFIG_DA_TTY=y
# CONFIG_DEVKMEM is not set
CONFIG_IMG_UCCP=y
CONFIG_IMG_SGX2D=y
CONFIG_SERIAL_8250=y
CONFIG_SERIAL_8250_CONSOLE=y
CONFIG_SERIAL_8250_NR_UARTS=2
CONFIG_SERIAL_8250_RUNTIME_UARTS=2
CONFIG_SERIAL_8250_DW=y
CONFIG_HW_RANDOM=y
CONFIG_HW_RANDOM_TIMERIOMEM=y
CONFIG_I2C=y
CONFIG_I2C_CHARDEV=y
CONFIG_I2C_IMG=y
CONFIG_SPI=y
CONFIG_SPI_IMG=y
CONFIG_GPIO_SYSFS=y
# CONFIG_HWMON is not set
CONFIG_WATCHDOG=y
CONFIG_IMGPDC_WDT=y
CONFIG_MEDIA_SUPPORT=y
CONFIG_MEDIA_RC_SUPPORT=y
# CONFIG_RC_DECODERS is not set
CONFIG_RC_DEVICES=y
CONFIG_IR_IMG=y
CONFIG_IR_IMG_NEC=y
CONFIG_IR_IMG_JVC=y
CONFIG_IR_IMG_SONY=y
CONFIG_IR_IMG_SHARP=y
CONFIG_IR_IMG_SANYO=y
CONFIG_FB_PDP_GFX_VIDEOMEM=3145728
CONFIG_BACKLIGHT_LCD_SUPPORT=y
CONFIG_LCD_CLASS_DEVICE=y
CONFIG_LCD_IMGPDI=y
# CONFIG_BACKLIGHT_CLASS_DEVICE is not set
CONFIG_FRAMEBUFFER_CONSOLE=y
CONFIG_FRAMEBUFFER_CONSOLE_DETECT_PRIMARY=y
CONFIG_LOGO=y
# CONFIG_LOGO_LINUX_MONO is not set
# CONFIG_LOGO_LINUX_VGA16 is not set
CONFIG_SOUND=y
CONFIG_SND=y
# CONFIG_SND_SUPPORT_OLD_API is not set
# CONFIG_SND_DRIVERS is not set
# CONFIG_SND_SPI is not set
# CONFIG_SND_USB is not set
CONFIG_SND_SOC=y
CONFIG_SND_TZ1090_SOC_TZ1090_01XX=y
CONFIG_USB=y
CONFIG_USB_DWC_OTG=y
CONFIG_USB_DWC_OTG_OTG=y
CONFIG_USB_GADGET=y
CONFIG_USB_GADGET_DWC_OTG=y
CONFIG_USB_CDC_COMPOSITE=m
CONFIG_MMC=y
CONFIG_MMC_DW=y
CONFIG_NEW_LEDS=y
CONFIG_LEDS_CLASS=y
CONFIG_LEDS_GPIO=y
CONFIG_LEDS_TRIGGERS=y
CONFIG_LEDS_TRIGGER_HEARTBEAT=y
CONFIG_RTC_CLASS=y
# CONFIG_IOMMU_SUPPORT is not set
CONFIG_EXT2_FS=y
# CONFIG_DNOTIFY is not set
CONFIG_VFAT_FS=y
CONFIG_TMPFS=y
# CONFIG_NETWORK_FILESYSTEMS is not set
CONFIG_NLS_CODEPAGE_437=y
CONFIG_NLS_ASCII=y
CONFIG_NLS_ISO8859_1=y
# CONFIG_ENABLE_WARN_DEPRECATED is not set
# CONFIG_ENABLE_MUST_CHECK is not set
# CONFIG_SCHED_DEBUG is not set
CONFIG_DEBUG_INFO=y
# CONFIG_FTRACE is not set
# CONFIG_CRYPTO_ANSI_CPRNG is not set
# CONFIG_CRYPTO_HW is not set
```

## arch/metag/drivers/Kconfig
```kconfig
menu "Additional Meta Device Drivers"

config IMG_DMAC
	depends on SOC_CHORUS2
	bool "IMG DMAC Driver"
	help
	  This enables the IMG DMAC driver

endmenu
```

## arch/metag/kernel/cpu/Kconfig
```kconfig
config METAG_CORE_SYSFS
	bool "Meta core sysfs interface"
	select SYSFS
	help
	  This enables a sysfs driver that gives access to the CPU core
	  parameters such as cycle counters and configuration registers.

config METAG_WRITE_COMBINER
	bool "Meta write combiner sysfs interface"
	depends on METAG_CORE_SYSFS
	help
	  This enables a sysfs driver that gives access to the CPU core
	  write combiner hardware.

config METAG_MEM_ARBITER
	bool "Meta memory arbiter sysfs interface"
	depends on METAG_CORE_SYSFS
	help
	  This enables a sysfs driver that gives access to the CPU core
	  memory arbiter hardware.

config METAG_CYCLE_COUNTER
	bool "Meta cycle counters"
	depends on METAG_CORE_SYSFS
	help
	  This enables a sysfs driver that gives access to the CPU core
	  cycle counters.

config METAG_PERFORMANCE_COUNTER
	bool "Meta performance counters"
	depends on METAG_CORE_SYSFS
	help
	  This enables a sysfs driver that gives access to the CPU core
	  performance counters.

config METAG_AMA_COUNTER
	bool "Meta Automatic MIPs Allocation counters"
	depends on METAG_CORE_SYSFS
	help
	  This enables a sysfs driver that gives access to the CPU core
	  Automatic MIPs Allocation counters.

config METAG_L2C_CONTROL
	bool "Level 2 Cache control"
	depends on METAG_CORE_SYSFS && METAG_L2C
	help
	  This enables a sysfs driver that provides access to the CPU core level
	  2 cache configuration (information like line size, ways of
	  associativity, total size, whether unified, and the hardware revision
	  number). It also provides controls to enable and disable the L2 cache,
	  to enable and disable prefetch, and to trigger write backs and
	  flushes, mostly for debug purposes. They can be found in
	  /sys/devices/system/cache/l2/.
```

## drivers/bus/Kconfig
```kconfig
#
# Bus Devices
#

menu "Bus devices"

config MVEBU_MBUS
	bool
	depends on PLAT_ORION
	help
	  Driver needed for the MBus configuration on Marvell EBU SoCs
	  (Kirkwood, Dove, Orion5x, MV78XX0 and Armada 370/XP).

config OMAP_OCP2SCP
	tristate "OMAP OCP2SCP DRIVER"
	depends on ARCH_OMAP2PLUS
	help
	  Driver to enable ocp2scp module which transforms ocp interface
	  protocol to scp protocol. In OMAP4, USB PHY is connected via
	  OCP2SCP and in OMAP5, both USB PHY and SATA PHY is connected via
	  OCP2SCP.

config OMAP_INTERCONNECT
	tristate "OMAP INTERCONNECT DRIVER"
	depends on ARCH_OMAP2PLUS

	help
	  Driver to enable OMAP interconnect error handling driver.

config TZ1090_SOCIF
	bool "TZ1090 SOCIF Driver"
	depends on SOC_TZ1090
	default y
	help
	  Driver to catch TZ1090 SOCIF errors such as when a memory access
	  times out. Instead of taking the target offline the current state is
	  logged in case it relates to the bad memory access.
endmenu
```

## drivers/net/wireless/uccp310wlan/Kconfig
```kconfig
config UCCP310WLAN
	tristate "ImgTec Universal Communications Core Platform (UCCP310) WLAN"
	depends on SOC_TZ1090
	depends on MAC80211
	help
	  Select to build the driver supporting ImgTec Universal Communications
	  Core Platform (UCCP310) WLAN.

	  If you select to build as a module it will be called uccp310wlan.

config UCCP310WLAN_DEBUG
	bool "Debugging messages"
	depends on UCCP310WLAN
	help
	  Select this option to build the UCCP310 WLAN driver with debugging
	  messages.
```

## drivers/usb/dwc_otg/Kconfig
```kconfig
menuconfig USB_DWC_OTG
	bool "Synopsys DWC OTG Controller"
	depends on 4XX_SOC || CPU_CAVIUM_OCTEON || SOC_TZ1090
	help
	  This driver provide USB Host and Device Controller support for the
	  Synopsys Designware USB OTG Core

choice
	prompt "Operating Mode"
	default USB_DWC_OTG_HOST_ONLY
	depends on USB_DWC_OTG
	help
	  Select the operating mode of the controller OTG does both Host and
	  Device with the selection made by the type of cable used.

config USB_DWC_OTG_OTG
	bool "OTG Support"
	depends on USB && USB_GADGET
	help
	  Select this for Full OTG Mode. Important You must select Synopsys
	  DWC_OTG as your peripheral controller in the Gadget Menu

config USB_DWC_OTG_HOST_ONLY
	bool "Host Only"
	depends on USB
	help
	  Select this for Host only operation no device support

config USB_DWC_OTG_DEVICE_ONLY
	bool "Device Only"
	depends on USB_GADGET
	help
	  Select this for Device only operation no host support

endchoice

choice
	prompt "Speed"
	default USB_DWC_OTG_SPEED_HIGH
	depends on USB_DWC_OTG
	help
	  Select the speed at which the USB Bus should operate at

config USB_DWC_OTG_SPEED_HIGH
	bool "High Speed (2.0)"
	help
	  Select this for High Speed (USB2.0 - 480Mbs/s) operation

config USB_DWC_OTG_SPEED_FULL
	bool "Full Speed (1.1)"
	help
	  Select this for Full Speed (USB1.1 - 12Mb/s) operation.
	  Useful when support for Full speed devices is needed and split
	  transactions are not avaialble (eg in descriptor dma mode).

endchoice

choice
	prompt "DMA Mode"
	default USB_DWC_OTG_DESC_DMA
	depends on USB_DWC_OTG
	help
	  Select the DMA mode the controller will operate in

config USB_DWC_OTG_SLAVE
	bool "Slave (no DMA)"
	help
	  Select this for Slave mode, no DMA will be performed.

config USB_DWC_OTG_BUFFER_DMA
	bool "Buffer DMA"
	help
	  Select this mode to use the Controllers internal buffer DMA mode

config USB_DWC_OTG_DESC_DMA
	bool "Descriptor based DMA"
	help
	  Select this mode to use the Controllers internal Descriptor based DMA
	  mode, Note this mode is only available on newer IP versions >2.9
	  and doesn't support split transactions.

config USB_DWC_OTG_EXT_DMA
	bool "External DMA"
	depends on 4XX_SOC
	help
	  Select this mode if you wish to use a DMA controller external to the
	  Controller IP.

endchoice

if USB_DWC_OTG

config USB_DWC_OTG_ISOCHRONOUS
	bool "Isochronous transfer support"
	depends on USB_DWC_OTG
	help
	  Select to enable support for Isochronous transfers

config USB_DWC_OTG_DEBUG
	bool "Verbose Debugging"
	depends on USB_DWC_OTG
	help
	  Select to enable verbose debuging, once enabled verbostiy level can be
	  set via a sysfs entry.

endif
```

## fs/imgdafs/Kconfig
```kconfig
config IMGDAFS_FS
	tristate "Meta DA filesystem support"
	depends on METAG_DA
	help
	  This enables the DA filesystem, which allows Linux to
	  to access files on a system attached via a debug adapter.
```

## sound/soc/chorus2/Kconfig
```kconfig
config SND_CHORUS2_SOC
	tristate "SoC Audio for the Frontier Silicon Chorus2 Chip"
	depends on SOC_CHORUS2
	help
	  Say Y or M if you want to add support for codecs attached to the
	  Chorus2 I2S Audio out interface.

config SND_CHORUS2_SOC_I2S
	tristate

config SND_CHORUS2_SOC_ATP_DP
	tristate "SoC Audio support for ATP-DP Base Layer"
	depends on SOC_CHORUS2
	select SND_CHORUS2_SOC
	select SND_CHORUS2_SOC_I2S
	select SND_SOC_WM8727
	help
	  Say Y if you want Audio support for your Metamorph ATP-DP board.
```

## sound/soc/tz1090/Kconfig
```kconfig
config SND_TZ1090_SOC
	tristate "SoC Audio for Toumaz Xenif TZ1090 (Comet)"
	depends on SOC_TZ1090 && TZ1090_MDC_DMA
	select SND_SOC_DMAENGINE_PCM
	help
	  Say Y or M if you want to add support for codecs attached to the
	  TZ1090 I2S Audio out interface.

config SND_TZ1090_SOC_I2S
	tristate

config SND_TZ1090_SOC_TZ1090_01XX
	tristate "SoC Audio support for 01SP/01TT Base Layer"
	depends on TZ1090_01XX || COMET_BUB
	select SND_TZ1090_SOC
	select SND_TZ1090_SOC_I2S
	select SND_SOC_TANSEN
	help
	  Say Y if you want Audio support for the Comet Metamorph/Minimorph/BuB.
```
